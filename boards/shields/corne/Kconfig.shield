## boards/shields/corne36/Kconfig.shield
```kconfig
config SHIELD_CORNE36_DONGLE
    def_bool $(shields_list_contains,corne36_dongle)
```

## boards/shields/my_corne36/Kconfig.shield
```kconfig
config SHIELD_MY_CORNE36_DONGLE
    def_bool $(shields_list_contains,my_corne36_dongle)
```

## boards/shields/mycorne36/Kconfig.shield
```kconfig
config SHIELD_MYCORNE36_DONGLE
    def_bool $(shields_list_contains,mycorne36_dongle)
```
